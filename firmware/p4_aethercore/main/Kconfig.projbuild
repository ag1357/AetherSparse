## firmware/p4_aethercore/main/Kconfig.projbuild
```kconfig
menu "AetherCore P4 runtime"

    comment "Device B is a replaceable compute accessory; USB is production"

    config AC_LINK_UART_BAUD
        int "Universal AetherLink UART fallback baud"
        default 921600

    config AC_LINK_UART_TX_PIN
        int "Universal UART TX GPIO (-1 until carrier-provisioned)"
        default -1

    config AC_LINK_UART_RX_PIN
        int "Universal UART RX GPIO (-1 until carrier-provisioned)"
        default -1

    choice AC_LINK_TOPOLOGY
        prompt "Device-B link topology"
        default AC_LINK_USB_CDC_DEVICE
        help
            Protocol-v2 remains above a byte-stream interface. USB CDC-ACM
            device is selected for the current P4 accessory; UART is the
            universal fallback. TCP is retained as historical diagnostics.

        config AC_LINK_USB_CDC_DEVICE
            bool "Production: Device B USB CDC-ACM device"

        config AC_LINK_UART_FALLBACK
            bool "Fallback: raw UART byte stream"

        config AC_LINK_DEPRECATED_TCP_DIAGNOSTIC
            bool "Deprecated diagnostic: Device B C6 + TCP"
            help
                Retains the Factory evidence in source for rollback/diagnosis.
                It is never selected by production defaults.
    endchoice

    config AC_BOOT_VERIFY_SKIP
        bool "Skip boot pack re-verify (interactive acceptance only)"
        default n
        help
            Skips the ~820 s boot-time pack region re-verify after it has
            already been qualified on this medium, so interactive link
            acceptance cycles in seconds instead of minutes. Prints a loud
            SKIPPED_INTERACTIVE_ACCEPTANCE marker. Production/qualification
            builds must leave this OFF (fail-closed verify on boot).

    config AC_TCP_AP_SSID
        string "Legacy diagnostic Device-B softAP SSID"
        default "AETHERCORE-V15"
        depends on AC_LINK_DEPRECATED_TCP_DIAGNOSTIC

    config AC_TCP_AP_PASS
        string "Legacy diagnostic Device-B softAP WPA2 passphrase"
        default "aethercore-v15-link"
        depends on AC_LINK_DEPRECATED_TCP_DIAGNOSTIC

    config AC_TCP_AP_CHANNEL
        int "Legacy diagnostic Device-B softAP channel"
        default 6
        depends on AC_LINK_DEPRECATED_TCP_DIAGNOSTIC

    config AC_TCP_PORT
        int "AetherLink protocol-v2 TCP port"
        default 9000

    config AC_TCP_LOOPBACK_SELFTEST
        bool "Run the in-device loopback protocol self-test at boot"
        default y
        depends on AC_LINK_DEPRECATED_TCP_DIAGNOSTIC
        help
            Connects a local client socket to the service, sends a golden
            Python-codec SESSION_OPEN frame, and strictly decodes the
            HEALTH+CAPABILITIES responses. Emits MEAS loopback:ok/fail.

endmenu
```
